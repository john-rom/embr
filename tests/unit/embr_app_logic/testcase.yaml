## tests/unit/embr_app_logic/testcase.yaml
```yaml
tests:
  unit.embr_app_logic:
    tags: embr app_logic
    type: unit
    platform_allow: unit_testing
```

## tests/unit/embr_classify/testcase.yaml
```yaml
tests:
  unit.embr_classify:
    tags: embr classify
    type: unit
    platform_allow: unit_testing
```

## tests/unit/embr_error_id/testcase.yaml
```yaml
tests:
  unit.embr_error_id:
    tags: embr error
    type: unit
    platform_allow: unit_testing
```

## tests/unit/embr_inference/testcase.yaml
```yaml
tests:
  unit.embr_inference:
    tags: embr
    type: unit
    platform_allow: unit_testing
```

## tests/unit/thingy53_led/testcase.yaml
```yaml
tests:
  unit.thingy53_led:
    tags: thingy53
    type: unit
    platform_allow: unit_testing
```

## tests/unit/thingy53_led_impl/testcase.yaml
```yaml
tests:
  unit.thingy53_led_impl:
    tags: thingy53
    type: unit
    platform_allow: unit_testing
```

## tests/unit/thingy53_mic/testcase.yaml
```yaml
tests:
  unit.thingy53_mic:
    tags: thingy53
    type: unit
    platform_allow: unit_testing
```

## tests/unit/thingy53_mic_impl/testcase.yaml
```yaml
tests:
  unit.thingy53_mic_impl:
    tags: thingy53
    type: unit
    platform_allow: unit_testing
```
