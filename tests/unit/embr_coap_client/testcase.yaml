## tests/unit/embr_coap_client/testcase.yaml
```yaml
tests:
  unit.embr_coap_client:
    tags: embr
    type: unit
    platform_allow: unit_testing
```

## tests/unit/embr_transport/testcase.yaml
```yaml
tests:
  unit.embr_transport:
    tags: embr
    type: unit
    platform_allow: unit_testing
```
